## conf/distro/base.conf
```bitbake
#@TYPE: Distribution
#@NAME: lite
#@DESCRIPTION: Simple OE-lite distro

require conf/distro/core.conf

DISTRO_USE_sysvinit = True

PREFERRED_PROVIDER_linux-headers = "linux-headers"

DISTRO_USE_hostname = "${DISTRO}-host"
```

## conf/machine/mpc8313erdb.conf
```bitbake
# -*- mode:python; -*-
MACHINE_CPU	= "powerpc-e300c3"

MACHINE_USE_kernel_defconfig = "83xx/mpc8313_rdb_defconfig"
MACHINE_USE_kernel_imagetype = "uImage"
MACHINE_USE_kernel_dtc = "1"

MACHINE_USE_base_rootfs_jffs2_options = "-b -p 16384 -s 16384 -e 16384 -n -f -q"

MACHINE_USE_uboot_config_file = "MPC8313ERDB.h"
MACHINE_USE_uboot_config = "MPC8313ERDB_33_config"

MACHINE_USE_uboot_extra_env = """uboot=0xfe000000
env=0xfe060000
uimage=0xfe100000
fdt=0xfe7f2000
vsc=0xfe7fe000
rootfs=0x400000
fdt_loadaddr=0x1000000
loadaddr=0x1004000
erase_env=protect off $env +1fff;erase $env +1fff;protect on $env +1fff
erase_fdt=protect off $fdt +3fff;erase $fdt +3fff
erase_vsc=protect off $vsc +1fff;erase $vsc +1fff
erase_rootfs=nand erase.chip
erase_uboot=protect off $uboot +$filesize;erase $uboot +$filesize
erase_uimage=protect off $uimage +$filesize;erase $uimage +$filesize
write_fdt=cp.b $fdt_loadaddr $fdt $filesize;protect on $fdt +3fff;cmp.b $fdt_loadaddr $fdt $filesize
write_vsc=cp.b $loadaddr $vsc $filesize;protect on $vsc +1fff;cmp.b $loadaddr $vsc $filesize
write_rootfs=nand write $loadaddr $rootfs $filesize;nand read $loadaddr+$filesize $rootfs $filesize;cmp $loadaddr $loadaddr+$filesize $filesize
write_uboot=cp.b $loadaddr $uboot $filesize;protect on $uboot +$filesize;cmp.b $loadaddr $uboot $filesize
write_uimage=cp.b $loadaddr $uimage $filesize;protect on $uimage +$filesize;cmp.b $loadaddr $uimage $filesize
tftp_fdt=dhcp $fdt_loadaddr $tftproot/$fdtfile
tftp_vsc=dhcp $loadaddr $tftproot/$vscfile
tftp_rootfs=dhcp $loadaddr $tftproot/$rootfsfile
tftp_uboot=dhcp $loadaddr $ubootfile
tftp_uimage=dhcp $loadaddr $tftproot/$bootfile
update_fdt=run tftp_fdt erase_fdt write_fdt
update_vsc=run tftp_vsc erase_vsc write_vsc
update_rootfs=run tftp_rootfs erase_rootfs write_rootfs
update_uboot=run tftp_uboot erase_uboot write_uboot
update_uimage=run tftp_uimage erase_uimage write_uimage
boot=bootm $uimage - $fdt_loadaddr
bootargs=init=/sbin/init console=ttyS0,115200 root=/dev/mtdblock3 rootfstype=jffs2 rw
bootcmd=run flashboot
bootdelay=-1
eth1addr=00:E0:0C:00:95:0b
ethaddr=00:E0:0C:00:95:09
flashboot=run load_fdt prep_fdt boot
load_fdt=fdt move $fdt $fdt_loadaddr 0x8000
prep_fdt=fdt addr $fdt_loadaddr 0x8000;fdt boardsetup"""

INCOMPATIBLE_RECIPES = "barebox barebox-xloader"
```

## conf/machine/pandaboard.conf
```bitbake
MACHINE_CPU	= "arm-omap4430"

MACHINE_USE_uboot_config = "omap4_panda_config"
MACHINE_USE_kernel_defconfig = "omap2plus_defconfig"
```
